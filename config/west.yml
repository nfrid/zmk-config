## config/west.yml
```yaml
manifest:
  remotes:
    - name: nfrid
      url-base: https://github.com/nfrid
  projects:
    - name: zmk
      remote: nfrid
      revision: main
      import: app/west.yml
  self:
    path: config
```
